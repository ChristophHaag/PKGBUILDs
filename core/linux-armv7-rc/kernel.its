## core/linux-armv7-rc/kernel.its
```
/dts-v1/;

/ {
    description = "Archlinux";
    #address-cells = <1>;
    images {
        kernel@1{
            description = "kernel";
            data = /incbin/("arch/arm/boot/zImage");
            type = "kernel_noload";
            arch = "arm";
            os = "linux";
            compression = "none";
            load = <0>;
            entry = <0>;
        };
        fdt@1{
            description = "tegra124-nyan-big";
            data = /incbin/("arch/arm/boot/dts/tegra124-nyan-big.dtb");
            type = "flat_dt";
            arch = "arm";
            compression = "none";
        };
    };
    configurations {
        default = "conf@1";
        conf@1{
            description = "tegra124-nyan-big";
            kernel = "kernel@1";
            fdt = "fdt@1";
        };
    };
};
```
